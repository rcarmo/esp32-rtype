## sdkconfig.defaults.esp32p4
```kconfig
# ESP32-P4 / M5Stack Tab5 experimental LC color configuration
CONFIG_IDF_TARGET="esp32p4"

# Connected Tab5 reports 16MB flash via ESP32-P4 USB-Serial/JTAG.
CONFIG_ESPTOOLPY_FLASHSIZE_16MB=y
CONFIG_ESPTOOLPY_FLASHSIZE="16MB"
# Match the official M5Tab5-UserDemo reference configuration.
CONFIG_ESPTOOLPY_FLASHMODE_QIO=y

# Tab5 has 32MB hex/16-line PSRAM according to M5Stack docs. Keep it in malloc
# capability pools so later LC RAM/framebuffer allocations can use SPIRAM.
CONFIG_SPIRAM=y
CONFIG_SPIRAM_MODE_HEX=y
CONFIG_SPIRAM_SPEED_200M=y
CONFIG_SPIRAM_USE_MALLOC=y
CONFIG_SPIRAM_MALLOC_ALWAYSINTERNAL=16384
CONFIG_SPIRAM_MALLOC_RESERVE_INTERNAL=32768
CONFIG_SPIRAM_MEMTEST=y

# Performance-oriented build for smoke tests and eventual emulator loops.
CONFIG_COMPILER_OPTIMIZATION_PERF=y

# Keep task watchdog permissive during early hardware/ROM bring-up.
CONFIG_ESP_TASK_WDT_TIMEOUT_S=10
CONFIG_ESP_TASK_WDT_CHECK_IDLE_TASK_CPU0=n
CONFIG_ESP_TASK_WDT_CHECK_IDLE_TASK_CPU1=n

# Console via USB-Serial/JTAG on the Tab5.
CONFIG_ESP_CONSOLE_USB_SERIAL_JTAG=y
CONFIG_ESP_CONSOLE_SECONDARY_NONE=y

# Wi-Fi/Bluetooth are not present on ESP32-P4; keep network stacks out of the LC target.
# CONFIG_ESP_WIFI_ENABLED is not set
# CONFIG_BT_ENABLED is not set


# Connected Tab5 reports ESP32-P4 rev v1.3. ESP-IDF 5.5 defaults target rev
# >=3.x for generic P4 configs, which can produce a bootloader that traps with
# Illegal instruction on this board. Match the rev-v1.x path used to make the
# official M5Tab5-UserDemo run on this hardware.
CONFIG_ESP32P4_SELECTS_REV_LESS_V3=y
CONFIG_ESP32P4_REV_MIN_100=y
CONFIG_ESP32P4_REV_MIN_FULL=100
CONFIG_ESP_REV_MIN_FULL=100
CONFIG_ESP32P4_REV_MAX_FULL=199
CONFIG_ESP_REV_MAX_FULL=199
CONFIG_ESP_DEFAULT_CPU_FREQ_MHZ_360=y
CONFIG_ESP_DEFAULT_CPU_FREQ_MHZ=360
```

## sdkconfig.defaults.esp32s3
```kconfig
# ESP32-8048S043C configuration
CONFIG_IDF_TARGET="esp32s3"

# Flash/PSRAM: connected board is ESP32-S3 N16R8 (16MB flash, 8MB octal PSRAM)
CONFIG_ESPTOOLPY_FLASHSIZE_16MB=y
CONFIG_ESPTOOLPY_FLASHSIZE="16MB"
CONFIG_ESPTOOLPY_FLASHMODE_DIO=y
CONFIG_ESPTOOLPY_FLASH_SAMPLE_MODE_STR=y
CONFIG_SPIRAM=y
CONFIG_SPIRAM_MODE_OCT=y
CONFIG_SPIRAM_SPEED_80M=y
CONFIG_SPIRAM_XIP_FROM_PSRAM=y
CONFIG_SPIRAM_FETCH_INSTRUCTIONS=y
CONFIG_SPIRAM_RODATA=y
CONFIG_SPIRAM_USE_MALLOC=y
CONFIG_SPIRAM_MALLOC_ALWAYSINTERNAL=16384
CONFIG_SPIRAM_TRY_ALLOCATE_WIFI_LWIP=y
CONFIG_ESP32S3_DEFAULT_CPU_FREQ_240=y
CONFIG_ESP32S3_DEFAULT_CPU_FREQ_MHZ=240
CONFIG_ESP32S3_DATA_CACHE_64KB=y
CONFIG_ESP32S3_DATA_CACHE_LINE_64B=y

# Performance optimization
CONFIG_COMPILER_OPTIMIZATION_PERF=y

# Watchdog settings
CONFIG_ESP_TASK_WDT_TIMEOUT_S=10
CONFIG_ESP_TASK_WDT_CHECK_IDLE_TASK_CPU0=n
CONFIG_ESP_TASK_WDT_CHECK_IDLE_TASK_CPU1=n

# Disable Bluetooth (not used in Cydintosh)
# CONFIG_BT_ENABLED is not set

# Console output
CONFIG_ESP_CONSOLE_UART=y

# WiFi (STA mode)
CONFIG_ESP_WIFI_ENABLED=y
CONFIG_ESP_WIFI_STA_CONNECTED_SCAN=y

# Keep WiFi buffers modest, but S3+PSRAM has more headroom than CYD.
CONFIG_ESP_WIFI_DYNAMIC_RX_BUFFER_NUM=8
CONFIG_ESP_WIFI_DYNAMIC_TX_BUFFER_NUM=8
CONFIG_ESP_WIFI_STATIC_RX_BUFFER_NUM=4
CONFIG_ESP_WIFI_STATIC_RX_BUFFER_SIZE=1600
CONFIG_ESP_WIFI_RX_BA_WIN=4
CONFIG_ESP_WIFI_MGMT_BUFFER_NUM=4

# MQTT Configuration
CONFIG_MQTT_PROTOCOL_5=n
CONFIG_MQTT_TRANSPORT_SSL=n
CONFIG_MQTT_TRANSPORT_WEBSOCKET=n
CONFIG_MQTT_TRANSPORT_WEBSOCKET_SECURE=n
```
